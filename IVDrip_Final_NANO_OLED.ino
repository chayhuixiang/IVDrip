// OLED display setup

#include <Wire.h> //I2C library
#include <Adafruit_GFX.h> // OLED library
#include <Adafruit_SSD1306.h> // OLED library

#define SCREEN_WIDTH 128 // OLED display width, in pixels
#define SCREEN_HEIGHT 64 // OLED display height, in pixels

#define OLED_RESET     4 // Reset pin # (or -1 if sharing Arduino reset pin)
#define SCREEN_ADDRESS 0x3C ///< See datasheet for Address; 0x3D for 128x64, 0x3C for 128x32
Adafruit_SSD1306 display(SCREEN_WIDTH, SCREEN_HEIGHT, &Wire, OLED_RESET);

// arduino pin setup
const int sensor = A3; // the pin that the sensor reads the light data from
const int ledPin = 3; // the pin that the transistor LED is attached to
const int buzzer = 2; // the pin that the buzzer is attached to

// reading and storing sensor data setup
int sensorReading; // reading from sensor pin
int prevSensorReading; // compare previous sensor reading to find drop in sensor reading
int pPrevSensorReading; // compare previous previous sensor reading to find drop in alternative sensor readings

// determining whether drop detected setup
bool dropDetected = false; // boolean value to determine whether drop has been detected or not
bool prevDropDetected = false;

// storing drop times setup
const int dropnumber = 6;
long unsigned droptimes[dropnumber];

// calculation of time per drop and drops per second
long unsigned highestDT = 0;
long unsigned lowestDT = 0;
int dropIndexNo = 0;
int timePerDrop;
float dropsPerSecond;
float dropsPerMinute;
int dropCounter;
int counter = 0;

// to communicate with both cores
int buffer = 0;

// batt lvl indicator variables & constants
const int battery = A2;
const int numReadings = 10;

int readings[numReadings];
int readIndex = 0;
int battTotal = 0;
int battAverage = 0;
float voltage;
bool batteryIndicator[] = {0,0,0,0}; // determine the state of the battery

// OLED display button
const int buttonPin = 5;    // the pin that the pushbutton is attached to
unsigned long displayMillis = 0;

// display button state variables
int buttonState = 0;         // current state of the button
int lastButtonState = 0;     // previous state of the button
bool displayState = true; // OLED state

// time variables for button:
unsigned long previousMillis = 0;
unsigned long currentMillis;

// reset button variables
const int resetButton = 6;
int resetButtonState = 0;
int rLastButtonState = 0;

// buzzer variables
long unsigned dropDetTime;
float prevDPM;
bool buzzerOn = false;
bool buzzerPlay = false;
int dPMDiff;
unsigned long buzzerMillis = 0;
unsigned long pBuzzerMillis;

// '3logytech only logo grayscale', 128x64px
  const unsigned char myBitmap [] PROGMEM = {
  0x00, 0x00, 0x00, 0x00, 0x00, 0x00, 0x00, 0x00, 0x00, 0x00, 0x00, 0x00, 0x00, 0x00, 0x00, 0x00, 
  0x00, 0x00, 0x00, 0x00, 0x00, 0x00, 0x00, 0x00, 0x00, 0x00, 0x00, 0x00, 0x00, 0x00, 0x00, 0x00, 
  0x00, 0x00, 0x00, 0x00, 0x00, 0x00, 0x00, 0x00, 0x00, 0x00, 0x00, 0x00, 0x00, 0x00, 0x00, 0x00, 
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  0x00, 0x00, 0x00, 0x00, 0x00, 0x00, 0x00, 0x00, 0x00, 0x00, 0x00, 0x00, 0x00, 0x00, 0x00, 0x00
  };

// 'Full_Batt_Resized', 128x64px
const unsigned char fullBitmap [] PROGMEM = {
  0x00, 0x00, 0x00, 0x00, 0x00, 0x00, 0x00, 0x00, 0x00, 0x00, 0x00, 0x00, 0x00, 0xff, 0xff, 0xfc, 
  0x00, 0x00, 0x00, 0x00, 0x00, 0x00, 0x00, 0x00, 0x00, 0x00, 0x00, 0x00, 0x00, 0x80, 0x00, 0x04, 
  0x00, 0x00, 0x00, 0x00, 0x00, 0x00, 0x00, 0x00, 0x00, 0x00, 0x00, 0x00, 0x00, 0x80, 0x00, 0x04, 
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  0x00, 0x00, 0x00, 0x00, 0x00, 0x00, 0x00, 0x00, 0x00, 0x00, 0x00, 0x00, 0x00, 0x00, 0x00, 0x00
};

// 'Almost_Batt_Resized', 128x64px
const unsigned char almostBitmap [] PROGMEM = {
  0x00, 0x00, 0x00, 0x00, 0x00, 0x00, 0x00, 0x00, 0x00, 0x00, 0x00, 0x00, 0x00, 0xff, 0xff, 0xfc, 
  0x00, 0x00, 0x00, 0x00, 0x00, 0x00, 0x00, 0x00, 0x00, 0x00, 0x00, 0x00, 0x00, 0x80, 0x00, 0x04, 
  0x00, 0x00, 0x00, 0x00, 0x00, 0x00, 0x00, 0x00, 0x00, 0x00, 0x00, 0x00, 0x00, 0x80, 0x00, 0x04, 
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  0x00, 0x00, 0x00, 0x00, 0x00, 0x00, 0x00, 0x00, 0x00, 0x00, 0x00, 0x00, 0x00, 0x00, 0x00, 0x00
};

// 'Flat_Batt_Resized', 128x64px
const unsigned char flatBitmap [] PROGMEM = {
  0x00, 0x00, 0x00, 0x00, 0x00, 0x00, 0x00, 0x00, 0x00, 0x00, 0x00, 0x00, 0x00, 0xff, 0xff, 0xfc, 
  0x00, 0x00, 0x00, 0x00, 0x00, 0x00, 0x00, 0x00, 0x00, 0x00, 0x00, 0x00, 0x00, 0x80, 0x00, 0x04, 
  0x00, 0x00, 0x00, 0x00, 0x00, 0x00, 0x00, 0x00, 0x00, 0x00, 0x00, 0x00, 0x00, 0x80, 0x00, 0x04, 
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  0x00, 0x00, 0x00, 0x00, 0x00, 0x00, 0x00, 0x00, 0x00, 0x00, 0x00, 0x00, 0x00, 0x00, 0x00, 0x00
};

// 'Dead_Batt_Resized', 128x64px
const unsigned char deadBitmap [] PROGMEM = {
  0x00, 0x00, 0x00, 0x00, 0x00, 0x00, 0x00, 0x00, 0x00, 0x00, 0x00, 0x00, 0x00, 0xff, 0xff, 0xfc, 
  0x00, 0x00, 0x00, 0x00, 0x00, 0x00, 0x00, 0x00, 0x00, 0x00, 0x00, 0x00, 0x00, 0x80, 0x00, 0x04, 
  0x00, 0x00, 0x00, 0x00, 0x00, 0x00, 0x00, 0x00, 0x00, 0x00, 0x00, 0x00, 0x00, 0x80, 0x00, 0x04, 
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  0x00, 0x00, 0x00, 0x00, 0x00, 0x00, 0x00, 0x00, 0x00, 0x00, 0x00, 0x00, 0x00, 0x00, 0x00, 0x00
};

void setup() {
  // put your setup code here, to run once:
  Serial.begin(115200);

  for (int thisReading = 0; thisReading < numReadings; thisReading++) {
    readings[thisReading] = 0;
  }
  
  Wire.begin();
  
  pinMode(sensor,INPUT);
  pinMode(ledPin, OUTPUT);
//  pinMode(dropLedPin, OUTPUT);
  digitalWrite(ledPin,HIGH);
  pinMode(battery,INPUT);
  pinMode(buttonPin, INPUT_PULLUP);
  pinMode(buzzer,OUTPUT);
  pinMode(resetButton,INPUT_PULLUP);

  display.begin(SSD1306_SWITCHCAPVCC, SCREEN_ADDRESS); // start transmission to OLED
  display.ssd1306_command(SSD1306_SETCONTRAST); // set brightness to minimum to conserve battery
  display.ssd1306_command(1);
  
  display.clearDisplay(); //for Clearing the display
  display.drawBitmap(0, 0, myBitmap, 128, 64, WHITE); // draw 3logytech bitmap
  display.setTextSize(1);
  display.setTextColor(WHITE);
  display.setCursor(5,0);
  display.print("Trilogy Technologies");
  display.display();
  delay(5000);
}

// function to display the drip rate
void displayDripRate(){
  display.clearDisplay(); // clear display
  display.setTextColor(WHITE); // settings color
  display.setTextSize(2); // sets text size
  display.setCursor(0,0); // sets cursor coordinates
  display.print("DripRate");
  display.setTextSize(1);
  display.setCursor(0,20);
  display.print("DPS: ");
  display.print(dropsPerSecond);
  display.print(" DPM: ");
  display.print(dropsPerMinute);
  display.setCursor(0,40);
  display.print("Drop No: " );
  display.print(counter);
}

void loop(){

  sensorReading = analogRead(sensor); // read sensor 

  //if (sensorReading <= 600 && prevDropDetected == false){ // condition to test if drop has been detected
  if (pPrevSensorReading - sensorReading >= 100 && prevDropDetected == false){ // alternative condition to test if drop has been detected using drop in sensor Reading
    dropDetected = true;
    Serial.println("-----DROP DETECTED-----");
    buffer++;
  }
  
  //if (dropDetected == true && sensorReading >= 650){ // condition to test if water stream has been cut after drop was detected
  if (dropDetected == true && sensorReading - prevSensorReading >= 100) { // alternative condition to test if drop has been detected using drop in sensor Reading
    dropDetected = false;
  }

  pPrevSensorReading = prevSensorReading; //pPrevSensorReading to compare drop in alternative sensor reading values
  prevSensorReading = sensorReading; // prevSensorReading to compare drop in sensor reading values
  prevDropDetected = dropDetected; // prevDropDetected to prevent one drop from registering multiple readings

  if (buffer > 0) {
    droptimes[dropIndexNo] = millis(); // stores time of drop in array
    dropDetTime = millis();
    dropIndexNo++;  
    counter++;
    if (dropIndexNo >= dropnumber){ // if 11th entry, overwrite the 1st entry, 21st entry overwrite 11th, so on and so forth; 12th overwrite 2nd....
      dropIndexNo = 0;
    }
    buffer--;
  }

  lowestDT = droptimes[0]; // initialise lowestDropTime to first value

  dropCounter = 0;
  
  for (int i=0;i<dropnumber;i++){ // for loop through the droptimes in the droptime array
//    Serial.print(String(i) + ": " + String(droptimes[i]) + " | " ); // loop through droptime array and print its elements
    if (droptimes[i] > highestDT){ // calculate highest Drop Time in the droptime array, stored in highestDT
      highestDT = droptimes[i];
    }
    else if (droptimes[i] < lowestDT && droptimes[i] != 0 ){ // calculate lowest Drop Time in droptime array, stored in lowestDT
      lowestDT = droptimes[i];
    }
    if (droptimes[i] != 0){ // count the number of readings in droptimes array
      dropCounter++;
    }
  }

  if (dropCounter-1 > 0){
      timePerDrop = (highestDT - lowestDT)/(dropCounter-1); // calculate time needed per drop (millisecond/drop)
  }
  
  dropsPerSecond = 1000/((float)timePerDrop); // calculate the number of drops per second
  dropsPerMinute = 60000/((float)timePerDrop); // calculate the number of drops per minute

// display info
  Serial.println(sensorReading);
//  Serial.println("sensorReading: " + String(sensorReading) + "dropCounter: " + String(counter) + " | highestDT: " + String(highestDT) + " | lowestDT: " + String(lowestDT) + " | dropsPerSecond: " + String(dropsPerSecond) + " | dropsPerMinute: " + String(dropsPerMinute));
  // batt level indicator
  battTotal = battTotal - readings[readIndex];
  readings[readIndex] = analogRead(battery);
  battTotal = battTotal + readings[readIndex];
  readIndex++;

  if (readIndex >= numReadings) {
    readIndex = 0;
  }
  
  battAverage = battTotal / numReadings;
  
  voltage = 5.25 * battAverage / 1024;  

  //OLED display button

  currentMillis = millis();
  
  if (millis() - displayMillis > 600000){
    //Serial.println('off display');
    display.ssd1306_command(SSD1306_DISPLAYOFF);
    displayMillis = millis();
    displayState = false;
  }
  
  if (currentMillis - previousMillis >= 50){ // delay without delay() function
    previousMillis = currentMillis;
    buttonState = digitalRead(buttonPin);
    resetButtonState = digitalRead(resetButton);
    //Serial.println("buttonState: "+String(buttonState));
    //Serial.println("resetButtonState: "+String(resetButtonState));

    if (buttonState != lastButtonState && buttonState == LOW) {
      displayState = !displayState;
      if (!displayState){
        Serial.println('off display');
        display.ssd1306_command(SSD1306_DISPLAYOFF); // turn display off
        displayMillis = millis();
      } else {
        Serial.println('on display');
        display.ssd1306_command(SSD1306_DISPLAYON); // turn display on
        displayMillis = millis();
      }
    }

    if (resetButtonState != rLastButtonState && resetButtonState == LOW) {
      Serial.println('Reset!');
      buzzerOn = false;
      for (int i = 0; i < dropnumber ; i++){
        droptimes[i] = 0;
      }
      counter = 0;
      dropIndexNo = 0;
      highestDT = 0;
      lowestDT = 0;
      timePerDrop = 0;
      dropCounter = 0;
      dropsPerSecond = 0;
      dropsPerMinute = 0;      
    }
    // save the current state as the last state, for next time through the loop
    lastButtonState = buttonState;
    rLastButtonState = resetButtonState;
  }

  if (displayState){
    displayDripRate(); // displays drip rate
      if (voltage <= 3.3){ // change batteryIndicator according to battery level
        batteryIndicator[0] = 1; 
        batteryIndicator[1] = 0;
        batteryIndicator[2] = 0;
        batteryIndicator[3] = 0;
      } // dead battery code

      else if (voltage <= 3.73 && voltage >= 3.4){
        batteryIndicator[0] = 0;
        batteryIndicator[1] = 1;
        batteryIndicator[2] = 0;
        batteryIndicator[3] = 0;
      } // flat battery code

      else if (voltage <= 3.85 && voltage >= 3.77){
        batteryIndicator[0] = 0;
        batteryIndicator[1] = 0;
        batteryIndicator[2] = 1;
        batteryIndicator[3] = 0;
      } // almost batt code

      else if (voltage >= 3.89){
        batteryIndicator[0] = 0;
        batteryIndicator[1] = 0;
        batteryIndicator[2] = 0;
        batteryIndicator[3] = 1;

      } // full batt code
      
      if (batteryIndicator[0]){ // display battery according to batteryIndicator
        display.drawBitmap(0, 0, deadBitmap, 128, 64, WHITE); // display.drawBitmap(x position, y position, bitmap data, bitmap width, bitmap height, color)
      } else if (batteryIndicator[1]){
        display.drawBitmap(0, 0, flatBitmap, 128, 64, WHITE); // display.drawBitmap(x position, y position, bitmap data, bitmap width, bitmap height, color)
      } else if (batteryIndicator[2]){
        display.drawBitmap(0, 0, almostBitmap, 128, 64, WHITE); // display.drawBitmap(x position, y position, bitmap data, bitmap width, bitmap height, color)
      } else if (batteryIndicator[3]){
        display.drawBitmap(0, 0, fullBitmap, 128, 64, WHITE); // display.drawBitmap(x position, y position, bitmap data, bitmap width, bitmap height, color)
      }
      display.display();
  };

  // buzzer code
  dPMDiff = dropsPerMinute - prevDPM; 
  if (counter >= 100 && (abs(dPMDiff) >= (20+dropsPerMinute/10) || millis() - dropDetTime >= 10000)){ // turn on buzzer when more than 100 drops, and either diffDPM has changed or theres no drops coming
    buzzerOn = true;
  }

  if (buzzerOn){
    buzzerMillis = millis();
    if (buzzerMillis - pBuzzerMillis >= 1000){
        pBuzzerMillis = buzzerMillis;
        buzzerPlay = !buzzerPlay;
        if (buzzerPlay){
          tone(buzzer,1000); // buzz the buzzer    
        } else {
                                                                                                                                                                                                                                                                                                                                                                                                                                                                                                                                                                                                                                                                                                                                                                                                                                                                                                                                                                                                                                                                                                                                                                                                                                                                                                                                                                                                                                                                                                                                                                                                                                                                                                                                                                                                                                                                                                                                                                                                                                                                                                                                                                                                                                                                                                                                                                                                                                                                                                                                                                                                                                                                                                                                                                                                                                                                                                                                                                                                                                                                                                                                                                                                                                                                                                                                                                                                                                                                                                                                                                                                                                                                                                                                                                                                                                                                                                                                                                                                                                                                                                                                                                                                                                                                                                                                                                                                                                                                                                                                                                                                                                                                                                                                                                                                                                                                                                                                                                                                                                                                                                                                                                                                                                                                                                                                                                                                                                                                                                                                                                                                                                                                                                                                                                                                                                                                                                                                                                                                                                                                                                                                                                                                                                                                                                                                                                                                                                                                                                                                                                                                                                                                                                                                                                                                                                                                                                                                                                                                                                                                                                                                                                                                                                                                                                                                                                                                                                                                                                                                                                                                                                                                                                                                                             noTone(buzzer);
        }
    }
    //digitalWrite(buzzer,HIGH);
  } else {
    //digitalWrite(buzzer,LOW);
    noTone(buzzer); // stop buzzing the buzzer
  }
//  Serial.println("dropsPerMinute:" + String(dropsPerMinute));
//  Serial.println("dropsPerMinute: " + String(dropsPerMinute)+ " | prevDPM: " + String(prevDPM) + " | dPMDiff: " + String(abs(dPMDiff)));
  prevDPM = dropsPerMinute;

//  Serial.println(voltage);
  delay(1);
}
